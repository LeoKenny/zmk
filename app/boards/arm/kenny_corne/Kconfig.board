## app/boards/arm/kenny_corne/Kconfig.board
```kconfig
config BOARD_CORNE_LH
    bool "corne LH"
    depends on SOC_NRF52840_QIAA

config BOARD_CORNE_RH
    bool "corne RH"
    depends on SOC_NRF52840_QIAA
```

## app/boards/arm/kenny_corne/Kconfig.defconfig
```kconfig
if BOARD_CORNE_LH

config BOARD
    default "corne lh"

config ZMK_SPLIT_BLE_ROLE_CENTRAL
    default y

endif # BOARD CORNE_LH

if BOARD_CORNE_RH

config BOARD
    default "corne rh"

endif # BOARD CORNE_RH


if BOARD_CORNE_LH || BOARD_CORNE_RH

config ZMK_SPLIT
    default y

config BT_CTLR
    default BT

config ZMK_KEYBOARD_NAME
    default "kenny corne"

config ZMK_KSCAN_MATRIX_WAIT_BETWEEN_OUTPUTS
    default 5

config PINCTRL
    default y

if USB

config USB_NRFX
    default y

config USB_DEVICE_STACK
    default y

endif # USB

endif # BOARD_CORNE_LH || BOARD_CORNE_RH
```
